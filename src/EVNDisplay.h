#ifndef EVNDisplay_h
#define EVNDisplay_h

#include <Arduino.h>
#include <Wire.h>
#include "EVNAlpha.h"
#include "U8g2/src/U8g2lib.h"

#define OLED_ADDR     0x3C
#define SCREEN_HEIGHT 64
#define SCREEN_WIDTH  128
#define LOGO_HEIGHT   54
#define LOGO_WIDTH    95
#define NO_OF_ROWS    (SCREEN_HEIGHT / 8)
#define MAX_CHAR      (SCREEN_WIDTH / 8)

#define DISPLAY_0DEG false
#define DISPLAY_180DEG true

class EVNDisplay
{
public:
  EVNDisplay(uint8_t port, bool rotate = DISPLAY_0DEG);
  void begin();
  void splashEVN();
  void rotate();
  void clear();
  void clearLine(uint8_t row);

  template <typename T>
  void writeData(uint8_t row, T data)
  {
    uint8_t prev_port = EVNAlpha::sharedPorts().getPort();
    EVNAlpha::sharedPorts().setPort(_port);
    uint8_t rowc = constrain(row, 0, NO_OF_ROWS - 1);
    String datas = String(data);
    if (datas.length() > (MAX_CHAR - _rownamelen[rowc]))
    {
      datas = datas.substring(0, (MAX_CHAR - _rownamelen[rowc]));
    }

    for (int i = _rownamelen[rowc] + datas.length(); i < MAX_CHAR; i++)
    {
      _display8x8->drawGlyph(i, rowc, ' ');
    }

    _display8x8->setCursor(_rownamelen[rowc], rowc);
    _display8x8->print(datas);
    EVNAlpha::sharedPorts().setPort(prev_port);
  };

  template <typename T>
  void writeLabel(uint8_t row, T label)
  {
    uint8_t prev_port = EVNAlpha::sharedPorts().getPort();
    EVNAlpha::sharedPorts().setPort(_port);
    uint8_t rowc = constrain(row, 0, NO_OF_ROWS - 1);
    String labels = String(label);
    if (labels.length() > MAX_CHAR)
    {
      labels = labels.substring(0, MAX_CHAR);
    }
    uint8_t namelen = labels.length();
    if (namelen < _rownamelen[rowc])
    {
      for (int i = namelen; i < _rownamelen[rowc]; i++)
      {
        _display8x8->drawGlyph(i, rowc, ' ');
      }
    }
    _rownamelen[rowc] = namelen;
    _display8x8->setCursor(0, rowc);
    _display8x8->print(labels);
    EVNAlpha::sharedPorts().setPort(prev_port);
  };

  template <typename T>
  void writeLine(uint8_t row, T line)
  {
    this->writeLine(row, line);
  };

private:
  uint8_t _port;
  bool _rotate;
  U8G2* _display;
  U8X8* _display8x8;

public:
  uint8_t _rownamelen[NO_OF_ROWS] = { 0 };
};

static const unsigned char logo[] = {
   0x00, 0x00, 0x00, 0x00, 0x00, 0x00, 0x00, 0x00, 0x00, 0x00, 0x00, 0x00,
  0x00, 0x00, 0x00, 0x00, 0x00, 0x00, 0x00, 0x00, 0x00, 0x00, 0x00, 0x00,
  0x00, 0x00, 0x00, 0x00, 0x00, 0x00, 0x00, 0x00, 0x00, 0x00, 0x00, 0x00,
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  0x00, 0x00, 0x00, 0x00, 0x00, 0x00, 0x00, 0x00, 0x00, 0x00, 0x00, 0x00,
};


#endif